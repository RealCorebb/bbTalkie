## esp-idf/components/hardware_driver/Kconfig.projbuild
```kconfig
menu "Audio Media HAL"

choice AUDIO_BOARD
    prompt "Audio hardware board"
    default ESP32_S3_KORVO_1_V4_0_BOARD
    help
        Select an audio board to use

config ESP32_KORVO_V1_1_BOARD
    bool "ESP32-Korvo"
    depends on IDF_TARGET_ESP32
config ESP32_S3_BOX_BOARD
    bool "ESP32-S3-Box"
    depends on IDF_TARGET_ESP32S3
config ESP32_S3_BOX_3_BOARD
    bool "ESP32-S3-Box-3"
    depends on IDF_TARGET_ESP32S3
config ESP32_S3_BBTALKIE
    bool "ESP32-S3-bbTalkie"
    depends on IDF_TARGET_ESP32S3
config ESP32_S3_KORVO_1_V4_0_BOARD
    bool "ESP32-S3-Korvo-1"
    depends on IDF_TARGET_ESP32S3
config ESP32_S3_KORVO_2_V3_0_BOARD
    bool "ESP32-S3-Korvo-2"
    depends on IDF_TARGET_ESP32S3
config ESP32_S3_EYE_BOARD
    bool "ESP32-S3-EYE"
    depends on IDF_TARGET_ESP32S3
config ESP32_P4_FUNCTION_EV_BOARD
    bool "ESP32-P4-Function_Ev"
    depends on IDF_TARGET_ESP32P4
endchoice


config ESP_WIFI_SSID
    string "WiFi SSID"
    default "myssid"
    help
        SSID (network name) for the example to connect to.

config ESP_WIFI_PASSWORD
    string "WiFi Password"
    default "mypassword"
    help
        WiFi password (WPA or WPA2) for the example to use.

choice ESP_WIFI_SAE_MODE
    prompt "WPA3 SAE mode selection"
    default ESP_STATION_EXAMPLE_WPA3_SAE_PWE_BOTH
    help
        Select mode for SAE as Hunt and Peck, H2E or both.
    config ESP_STATION_EXAMPLE_WPA3_SAE_PWE_HUNT_AND_PECK
        bool "HUNT AND PECK"
    config ESP_STATION_EXAMPLE_WPA3_SAE_PWE_HASH_TO_ELEMENT
        bool "H2E"
        depends on ESP_WIFI_ENABLE_SAE_H2E
    config ESP_STATION_EXAMPLE_WPA3_SAE_PWE_BOTH
        bool "BOTH"
        depends on ESP_WIFI_ENABLE_SAE_H2E
endchoice

config ESP_WIFI_PW_ID
    string "PASSWORD IDENTIFIER"
    depends on  ESP_STATION_EXAMPLE_WPA3_SAE_PWE_HASH_TO_ELEMENT|| ESP_STATION_EXAMPLE_WPA3_SAE_PWE_BOTH
    default ""
    help
        password identifier for SAE H2E

config ESP_MAXIMUM_RETRY
    int "Maximum retry"
    default 5
    help
        Set the Maximum retry to avoid station reconnecting to the AP unlimited when the AP is really inexistent.

choice ESP_WIFI_SCAN_AUTH_MODE_THRESHOLD
    prompt "WiFi Scan auth mode threshold"
    default ESP_WIFI_AUTH_WPA2_PSK
    help
        The weakest authmode to accept in the scan mode.
        This value defaults to ESP_WIFI_AUTH_WPA2_PSK in case password is present and ESP_WIFI_AUTH_OPEN is used.
        Please select ESP_WIFI_AUTH_WEP/ESP_WIFI_AUTH_WPA_PSK in case AP is operating in WEP/WPA mode.

    config ESP_WIFI_AUTH_OPEN
        bool "OPEN"
    config ESP_WIFI_AUTH_WEP
        bool "WEP"
    config ESP_WIFI_AUTH_WPA_PSK
        bool "WPA PSK"
    config ESP_WIFI_AUTH_WPA2_PSK
        bool "WPA2 PSK"
    config ESP_WIFI_AUTH_WPA_WPA2_PSK
        bool "WPA/WPA2 PSK"
    config ESP_WIFI_AUTH_WPA3_PSK
        bool "WPA3 PSK"
    config ESP_WIFI_AUTH_WPA2_WPA3_PSK
        bool "WPA2/WPA3 PSK"
    config ESP_WIFI_AUTH_WAPI_PSK
        bool "WAPI PSK"
endchoice

endmenu
```
